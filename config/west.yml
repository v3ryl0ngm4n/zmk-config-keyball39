## config/west.yml
```yaml
manifest:
  remotes:
    - name: zmkfirmware
      url-base: https://github.com/zmkfirmware
    - name: mochukeeb
      url-base: https://github.com/mochukeeb
    - name: denisekart
      url-base: https://github.com/denisekart
  projects:
    - name: zmk
      remote: zmkfirmware
      revision: v0.3
      import: app/west.yml
    - name: zmk-pmw3610-driver
      remote: mochukeeb
      revision: main
    - name: zmk-mouse-mover
      remote: denisekart
      revision: main
  self:
    path: config
```
